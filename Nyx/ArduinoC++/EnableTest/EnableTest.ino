#include <ESP32Servo.h>
#include <math.h>
#include <RocketPID.h>
#include <map>
#include <EnableFunction.h>

// variáveis do servo
Servo servo1;
Servo servo2;

std::map<int, float> myMap = {
  {-8, 1340}, // -8 -> 1348 - 1330
  {-7, 1358}, // -7 -> 1368 - 1349
  {-6, 1378}, // -6 -> 1387 - 1369
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  {8, 1650}   //  8 -> 1640 - 1659
};

// inicializa variaveis do controlador
float cantAngle;              // Variables of interest
float Kp = 0.005, Ki = 0.01, Kd = 0.000;
int setPoint = 0;
RocketPID testePID(setPoint, Kp, Ki, Kd);
float dado_filtrado;
float Output; //usado na loop (em graus)
float dutyCycle; //usado como input do servo, em microssegundos
int lastCantAngle = 0;     // em graus


// variáveis de controle de frequência de amostragem
int t0 = 0;
int t1 = 0;
int16_t delta = 0;
int dataCont = 0;

// Dados do RocketPy [time(s), w3(rad/s), aZ(m/s²), z(m)]
float Data[1865][4] = {
0.000000,0.000000,-9.8,667.909540,
0.000000,0.000000,-9.8,667.909540,
0.000000,0.000000,-9.8,667.909540,
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18.510000,0.000649,-9.473937,2048.501000,};

//Enable
double minAltitude = 1023; //dado pelo RocketPy
double apogeeAltitude = 2058; //dado pelo RocketPy
EnableFunction *enable = new EnableFunction(minAltitude, apogeeAltitude);

void setup() {
  Serial.begin(115200);
  servo1.attach(33); 
  servo2.attach(18);

  for (int pos = 0; pos <= 8; pos++){
    servo1.writeMicroseconds(myMap[pos]);
    servo2.writeMicroseconds(myMap[pos]);
    delay(100);
  }
  for (int pos = 8; pos >= 0; pos--){
    servo1.writeMicroseconds(myMap[pos]);
    servo2.writeMicroseconds(myMap[pos]);
    delay(100);
  }

  t0 = millis();
  Serial.println("INICIANDO");
  delay(3000);
}

void loop() {
   t1 = millis();
   if ((t1 - t0) >= 10 && dataCont <= 1864) {
    Serial.print(Data[dataCont][0]);
    Serial.print(",");
    Serial.print(Data[dataCont][1]);
    Serial.print(",");
    Serial.print(Data[dataCont][2]);
    Serial.print(",");
    Serial.println(Data[dataCont][3]);
//    Serial.print(",");
    dado_filtrado = Data[dataCont][1];
    cantAngle = testePID.computePID(dado_filtrado)*180/3.1416;
//    Serial.print(cantAngle);
//    Serial.print(",");
//    Serial.print(lastCantAngle);
//    Serial.print(",");
//    Serial.print(myMap[lastCantAngle]);
//    Serial.println(",");

    enable->addValues(Data[dataCont][2],Data[dataCont][3]);
    if (enable->getMotorOn() == true){
      Serial.print("TIME: ");Serial.print(Data[dataCont][0]);Serial.print("  |  ");Serial.println("MOTORON");
    }
    if (enable->getControlOn() == true){
      Serial.print("TIME: ");Serial.print(Data[dataCont][0]);Serial.print("  |  ");Serial.println("ENABLEON");
    }
    
    dataCont++;
    t0 = t1;
  }
  if(dataCont == 1864) {
    Serial.println("-------------DONE--------------");
    dataCont++;
  }
}
