#include <PID_v1.h>
#include <ESP32Servo.h>
#include <Wire.h>
#include <SPIFlash.h>
#include <SPI.h>

// variáveis do servo
Servo servo1;
Servo servo2;

// dado lido do vetor Data


// inicializa variaveis do controlador
float ServoOutput;              // Variables of interest
float Kp = 0.005, Ki = 0.01, Kd = 0.000;
//PID myPID(&dado_filtrado, &Output, &Setpoint, Kp, Ki, Kd, DIRECT);

// variáveis de controle de frequência de amostragem
int t0 = 0;
int t1 = 0;
int16_t delta = 0;
int periodo = 0.01;                                                     //Período de amostragem em segundos
int dataCont = 0;

float lastInput = 0.0;
float lastErr = 0.0;
int setPoint = 0;
float err;
float dado_filtrado;
float d_input;
float d_error;
float proportional;
float integral;
float derivative;
float dt = 0.01;
int lower = -8;
int upper = 8;
float Output; //usado na loop
float output; //usado na função computePID




// variáveis da memória
#define HSPI_MISO   12
#define HSPI_MOSI   13
#define HSPI_SCLK   14
#define HSPI_SS     15

//SPIClass *hspi = new SPIClass(HSPI);
//uint8_t chipSelect = 15;
//SPIFlash flash(chipSelect, hspi);

int16_t intermed;
int16_t concatenada; //variavel de leitura
int8_t byte0;
int8_t byte1;
int memCont = 0;

// Dados vindos do RocketPy [time(s), w3(rad/s), aZ(m/s²), z(m)]
float Data[370][4] = {
4.300000,14.232404,-12.708927,1023.807952,
4.310000,13.629274,-12.702243,1025.313747,
4.320000,13.068718,-12.695258,1026.818271,
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7.990000,0.192754,-11.176764,1497.367239};

void setup() {
  Serial.begin(115200);
  //hspi->begin(HSPI_SCLK, HSPI_MISO, HSPI_MOSI, HSPI_SS); //SCLK, MISO, MOSI, SS
  Wire.begin();
  //flash.begin();

  // Atribui pinos aos servos
  servo1.attach(33); 
  servo2.attach(18);

 for (int pos = 70; pos <= 90; pos += 1) { // goes from 0 degrees to 180 degrees
    // in steps of 1 degree
    servo1.write(pos);              // tell servo to go to position in variable 'pos'
    servo2.write(pos);
    delay(20);                       // waits 15ms for the servo to reach the position
  }
  for (int pos = 90; pos >= 70; pos -= 1) { // goes from 180 degrees to 0 degrees
    servo1.write(pos);              // tell servo to go to position in variable 'pos'
    servo2.write(pos);
    delay(20);                       // waits 15ms for the servo to reach the position
  }
  
  // Prepara controlador
  //Setpoint = 0; // Velocidade angular desejada
  //myPID.SetMode(AUTOMATIC); //turn the PID on
  //myPID.SetOutputLimits(-8, 8);
  // myPID.SetSampleTime(10); // The sample time is being manually controlled on the loop
  
  delay(2000);
  t0 = millis();
}

void loop() {
  t1 = millis();

   //if(dataCont <= 369) {
   if ((t1 - t0) >= 10 && dataCont <= 369) {
   
    dado_filtrado = Data[dataCont][1];
    Output = computePID(dado_filtrado)*180/3.1416;
    
    //myPID.Compute();
    // Convert canard output to servo output
    ServoOutput = Output + 90;
    // Write output on the servo
    Serial.println(ServoOutput);
    servo1.write(ServoOutput); // Output
    servo2.write((ServoOutput + 10)); // Output

    //intermed = int16_t(ServoOutput * 1000);
    //byte0 = (intermed & 255);
    //byte1 = ((intermed >> 8) & 255);
    //flash.writeByte(memCont, byte0);
    //memCont++;
    //flash.writeByte(memCont, byte1);
    //memCont++;

    //delta = int16_t(t1-t0);
    //byte0 = (delta & 255);
    //byte1 = ((delta >> 8) & 255);
    //flash.writeByte(memCont, byte0);
    //memCont++;
    //flash.writeByte(memCont, byte1);
    memCont++;
    
    dataCont++;
    t0 = t1;
  }
  if(dataCont == 370) {
    Serial.println("DONE");
    dataCont++;
  }
}

float computePID(float dadoFiltrado) {

    dado_filtrado = dadoFiltrado;

    //Compute error terms
    err = setPoint - dado_filtrado;
    d_input = dado_filtrado - lastInput;
    d_error = err - lastErr; 

    //Compute the proportional term
    proportional = Kp * err;

    //Compute integral and derivative terms
    integral += Ki * err * dt;
    integral = clamp(integral, lower, upper);  //Avoid integral windup

    derivative = -Kd * d_input / dt;

    //Compute final output
    output = proportional + integral + derivative;
    output = clamp(output, lower, upper);

    //Keep track of state
    lastInput = dado_filtrado;
    lastErr = err;
return output;
}

float clamp(float value, int lower, int upper) {
    int low;
    int up;
  
    low = lower;
    up = upper;
    if (value > up)
        return up;
    if (value < low)
        return low;
return value;
}
